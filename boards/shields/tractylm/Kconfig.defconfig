## boards/shields/tractylm/Kconfig.defconfig
```kconfig
# Copyright (c) 2020 Ryan Cross
# SPDX-License-Identifier: MIT

if SHIELD_TRACTYLM_LEFT

config ZMK_KEYBOARD_NAME
	default "TractylM"

config ZMK_SPLIT_BLE_ROLE_CENTRAL
	default y
	
endif

if SHIELD_TRACTYLM_LEFT || SHIELD_TRACTYLM_RIGHT

config ZMK_SPLIT
	default y

endif
```

## boards/shields/tractylm/Kconfig.shield
```kconfig
config SHIELD_TRACTYLM_LEFT
    def_bool $(shields_list_contains,tractylm_left)

config SHIELD_TRACTYLM_RIGHT
    def_bool $(shields_list_contains,tractylm_right)
```
